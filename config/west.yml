## config/west.yml
```yaml
manifest:
  remotes:
    - name: zmkfirmware
      url-base: https://github.com/zmkfirmware
    - name: sayu-hub
      url-base: https://github.com/sayu-hub
    - name: caksoylar  # <-- new entry
      url-base: https://github.com/caksoylar  
    - name: urob
      url-base: https://github.com/urob
  projects:
    - name: zmk
      remote: urob
      revision: main
      import: app/west.yml
    - name: zmk-pmw3610-driver
      remote: sayu-hub
      revision: main
    - name: zmk-rgbled-widget  # <-- new entry
      remote: caksoylar
      revision: main
    - name: zmk-pointing
      remote: sayu-hub
      revision: main
  self:
    path: config
```
